## drivers/media/dvb-frontends/cxd2858/Kconfig
```kconfig
# SPDX-License-Identifier: GPL-2.0

config DVB_CXD2858
	tristate "Sony CXD2858 DVB-T2/T tuner + demodulator"
	depends on DVB_CORE && SPI
	default m if !MEDIA_SUBDRV_AUTOSELECT
	help
	  Say Y when you want to support this frontend.
```

## drivers/media/dvb-frontends/mxl692/Kconfig
```kconfig
config DVB_MXL692
	tristate "Maxlinear MxL692 ATSC/QAM"
	depends on DVB_CORE && I2C
	default m if !MEDIA_SUBDRV_AUTOSELECT
	help
	  Say Y when you want to support this frontend.
```

## drivers/media/dvb-frontends/rs6000/Kconfig
```kconfig
config DVB_M88RS6000B
	tristate "Montage Tehnology RS6000B based"
	depends on DVB_CORE && I2C
	default m if !MEDIA_SUBDRV_AUTOSELECT
	help
	  A DVB-S/S2 tuner module. Say Y when you want to support this frontend.
```
